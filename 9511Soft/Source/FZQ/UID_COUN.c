
#include  <stm32f10x.h>


u32 Fml_Constant=0X8f692ADC; // 输入到公式的常数
u8 *C= (u8*)&Fml_Constant;//把常量转换为数组
u16 Fml_CRC16;

/********************************************************************
函数功能：CRC16 运算(此函数不是公式,而是下面的一百多条公式中有些会调用此函数数参
与运算,实际应用时抄在自已的程序中即可)
入口参数：p 为数据指针，len 为数据长度
返 回：8 位结果
备 注：
********************************************************************/
u16 Caculate_CRC16(u8 *p,u8 len)//此函数是用于下面的一百多个公式内部调用的.用户抄上即可.
{
	u8 i;
	while(len--)
	{
		for(i=0x80; i!=0; i>>=1)
		{
			if((Fml_CRC16 & 0x8000) != 0)
				{
					Fml_CRC16 <<= 1;
					Fml_CRC16 ^= 0x1021;
				}
			else
				{
					Fml_CRC16 <<= 1;
				}
			if((*p&i)!=0)
				{
					Fml_CRC16 ^= 0x1021;
				}
		}
		p++;
	}
	return Fml_CRC16;
}

/********************************************************************
函数功能：公式
入口参数：D
备 注：
********************************************************************/
void Caculate_120(u8 *D,u8 *Result)
{
u8 *crc;
u16 dat;
crc = (u8*)&dat;
Fml_CRC16 = 0;
dat = Caculate_CRC16(D+6,6);
Result[0] = crc[0];
Result[1] = crc[1];
Result[2] = C[2] ^ D[0] ^ D[1] ^ D[2]^ D[3] ;
Result[3] = C[3] ^ D[4] ^ D[5] ;
}
/// End of file -----------------------------------------------------------------------------------------
